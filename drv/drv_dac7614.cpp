////////////////////////////////////////////////////////////////////////////////
/// @file           drv_dac7614.c
/// @brief          dac7614の初期化・出力の実行
/// @author         作成者
/// @date           ファイル作成年月日
/// $Version:       1.00$
/// $Revision:      1.00$
/// @note           ファイルに備考などを明記する場合はここへ書き込む
/// @attention      ファイルに注意書きなどを明記する場合はここへ書き込む
/// @par            History
///                 ファイルに履歴などを明記する場合はここへ書き込む
///
/// Copyright (c) YYYY Sample Inc. All Rights reserved.
///
/// - 本ソフトウェアの一部又は全てを無断で複写複製（コピー）することは、
///   著作権侵害にあたりますので、これを禁止します。
/// - 本製品の使用に起因する侵害または特許権その他権利の侵害に関しては
///   当社は一切その責任を負いません。
///
////////////////////////////////////////////////////////////////////////////////

/*****************************************************************************/
/*****************************************************************************/
/*  ヘッダファイルのインクルード                                              */
/*****************************************************************************/
/*****************************************************************************/
#include <SPI.h>
#include "pinconf.h"
#include "../comm/typedef_arduino.h"


/*****************************************************************************/
/*****************************************************************************/
/*  自ヘッダファイルのインクルード                                            */
#define __GLOBAL_DEFINE__
/*****************************************************************************/
#include "drv_dac7614.h"

/*****************************************************************************/
/*****************************************************************************/
/* 型定義                                                                    */
/*****************************************************************************/
/*****************************************************************************/

////////////////////////////////////////////////////////////////////////////////
/// @typedef    typedef名
/// @brief      typedefの説明
///
////////////////////////////////////////////////////////////////////////////////



/*****************************************************************************/
/*****************************************************************************/
/* マクロ */
/*****************************************************************************/
/*****************************************************************************/
/////////////////////////////////////////////////////////////////////////////////
/// @def        define名
/// @brief      defineの説明
///
////////////////////////////////////////////////////////////////////////////////

/*****************************************************************************/
/*****************************************************************************/
/* クラス */
/*****************************************************************************/
/*****************************************************************************/

///////////////////////////////////////////////////////////////////////////////
/// @class      class名
/// @brief      classの説明
///
////////////////////////////////////////////////////////////////////////////////

////////////////////////////////////////////////////////////////////////////////
/// @struct     構造体名
/// @brief      構造体の説明
///
////////////////////////////////////////////////////////////////////////////////


////////////////////////////////////////////////////////////////////////////////
/// @enum       enum型名
/// @brief      enum型の説明
///
////////////////////////////////////////////////////////////////////////////////

/*****************************************************************************/
/*****************************************************************************/
/* 変数定義 */
/*****************************************************************************/
/*****************************************************************************/

////////////////////////////////////////////////////////////////////////////////
/// @var        dac7614SPISetting
/// @brief      DAC7614SPI設定
///
////////////////////////////////////////////////////////////////////////////////
SPISettings dac7614SPISetting(1000000, MSBFIRST, SPI_MODE3);

/*****************************************************************************/
/*****************************************************************************/
/* 内部関数宣言 */
/*****************************************************************************/
/*****************************************************************************/

/*****************************************************************************/
/*****************************************************************************/
/*****************************************************************************/
/* 関数定義 */
/*****************************************************************************/
/*****************************************************************************/
/*****************************************************************************/

/*****************************************************************************/
/*****************************************************************************/
/* グローバル関数定義 */
/*****************************************************************************/
/*****************************************************************************/

////////////////////////////////////////////////////////////////////////////////
/// @brief          関数の説明
/// @fn             関数名
/// @param[in]      引数(参照専用)
/// @param[out]     引数(ポインタ引数等)
/// @return         関数戻り値の説明
/// @author         関数作成者名
/// @date           関数作成年月日
/// @version        関数やソースにバージョンを明記する場合はここへ書き込む
/// @note           関数に備考などを明記する場合はここへ書き込む
/// @attention      関数に注意書きなどを明記する場合はここへ書き込む
/// @par            History
///                 ファイルに履歴などを明記する場合はここへ書き込む
///
////////////////////////////////////////////////////////////////////////////////

/** 
* @fn       void vdg_drv_dac7614_setup(void)
* @brief    Init DAC7614 IC 
* @return   void
*/
void vdg_drv_dac7614_setup(void)
{
    // SPIの初期化は全体に影響する変更点のためここに隠蔽できない
    // IOピンは占有資源のためここで宣言
    pinMode(PNCF_DAC7614_DACCS, OUTPUT);
     
    /// CSをネゲート
    digitalWrite(PNCF_DAC7614_DACCS, PNCF_DAC7614_DACCS_NEGATE);

    /// LOADDACをネゲート
    digitalWrite(PNCF_DAC7614_LOADDAC, PNCF_DAC7614_LOADDAC_NEGATE);

pinMode(PNCF_DAC7614_LOADDAC, OUTPUT);
}

void vdg_drv_dac7614_start(void)
{
    /* SPI初期化 */
    SPI.begin();
    /* MSB FAST */
    SPI.setBitOrder(MSBFIRST);
    /* 1MHz CLK */
    SPI.setClockDivider(SPI_CLOCK_DIV16);
    /* クロック負パルス 立ち上がりエッジサンプリング */
    SPI.setDataMode(SPI_MODE3);
    
    /// CSをネゲート
    digitalWrite(PNCF_DAC7614_DACCS, PNCF_DAC7614_DACCS_NEGATE);

    /// LOADDACをネゲート
    digitalWrite(PNCF_DAC7614_LOADDAC, PNCF_DAC7614_LOADDAC_NEGATE);

//    SPI.beginTransaction(dac7614SPISetting);
}

/** 
* @fn       void vdg_dac7614_output(u8 ch, u16 outputdat)
* @brief    Init DAC7614 IC 
* @return   void
*/
void vdg_drv_dac7614_output(u8 u8t_ch, u16 u16t_outputdat)
{
    u8  ch_tmp;
    u16  dat_tmp = 0;
    u8  shortdat = 0;
    if (u8t_ch < DRV_DAC7614_CHNUM)
    {
        //  正しいチャンネルのため受け取る
        ch_tmp = u8t_ch;
    }
    else
    {
        //  不正なチャンネル指定のため何もしない
        return ;
    }
    if (DRV_DAC7614_DACMAX < u16t_outputdat)
    {
        dat_tmp  = DRV_DAC7614_DACMAX -1;
    }
    else
    {
        dat_tmp = u16t_outputdat;
    }
    

    // CSアサート
    digitalWrite(PNCF_DAC7614_DACCS, PNCF_DAC7614_DACCS_ASSERT);
    // LOADDACネゲート
    digitalWrite(PNCF_DAC7614_LOADDAC, PNCF_DAC7614_LOADDAC_NEGATE);
    switch(ch_tmp)
    {
        case 0:
            dat_tmp = dat_tmp | 0x0000;
        break;

        case 1:
            dat_tmp = dat_tmp | 0x4000;
        break;

        case 2:
            dat_tmp = dat_tmp | 0x8000;
        break;

        case 3:
            dat_tmp = dat_tmp | 0xC000;
        break;
    }
    shortdat = (dat_tmp >> 8) & 0x00FF;
    SPI.transfer(shortdat);
    shortdat = dat_tmp & 0x00FF;
    SPI.transfer(shortdat);
    //  CSネゲート
    digitalWrite(PNCF_DAC7614_DACCS, PNCF_DAC7614_DACCS_NEGATE);
    //  LOADDACアサート
    digitalWrite(PNCF_DAC7614_LOADDAC, PNCF_DAC7614_LOADDAC_ASSERT);
    // LOADDACネゲート
    digitalWrite(PNCF_DAC7614_LOADDAC, PNCF_DAC7614_LOADDAC_NEGATE);
}

/** 
* @fn       void vdg_drv_dac7614_end(void)
* @brief    Init DAC7614 IC 
* @return   void
*/
void vdg_drv_dac7614_end(void)
{
//    SPI.endTransaction();
    SPI.end();
}

u16 u16g_drv_dac7614_convf(f4 f4t_voltage)
{
    ///    Vdac = DRV_DAC7614_VREF_L + N * ((DRV_DAC7614_VREF_H - DRV_DAC7614_VREF_L) / 4096)
    ///    Vdac - DRV_DAC7614_VREF_L =  N * ((DRV_DAC7614_VREF_H - DRV_DAC7614_VREF_L) / 4096)
    ///    N = (Vdac - DRV_DAC7614_VREF_L) /  ((DRV_DAC7614_VREF_H - DRV_DAC7614_VREF_L) / 4096)
    return  ((f4t_voltage  - DRV_DAC7614_VREF_L) *  DRV_DAC7614_CONV_A * ( 4096 / (DRV_DAC7614_VREF_H - DRV_DAC7614_VREF_L) ) 
                                            + DRV_DAC7614_CONV_B);
}

/*****************************************************************************/
/*****************************************************************************/
/* 内部関数定義 */
/*****************************************************************************/
/*****************************************************************************/

////////////////////////////////////////////////////////////////////////////////
/// @brief          関数の説明
/// @fn             関数名
/// @param[in]      引数(参照専用)
/// @param[out]     引数(ポインタ引数等)
/// @return         関数戻り値の説明
/// @author         関数作成者名
/// @date           関数作成年月日
/// @version        関数やソースにバージョンを明記する場合はここへ書き込む
/// @note           関数に備考などを明記する場合はここへ書き込む
/// @attention      関数に注意書きなどを明記する場合はここへ書き込む
/// @par            History
///                 ファイルに履歴などを明記する場合はここへ書き込む
///
////////////////////////////////////////////////////////////////////////////////

/*********************EOF******************************************************/
