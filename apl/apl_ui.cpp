////////////////////////////////////////////////////////////////////////////////
/// @file           ファイル名.c
/// @brief          ファイルの説明
/// @author         作成者
/// @date           ファイル作成年月日
/// $Version:       ファイルバージョン$
/// $Revision:      ファイルリビジョン$
/// @note           ファイルに備考などを明記する場合はここへ書き込む
/// @attention      ファイルに注意書きなどを明記する場合はここへ書き込む
/// @par            History
///                 ファイルに履歴などを明記する場合はここへ書き込む
///
/// Copyright (c) YYYY Sample Inc. All Rights reserved.
///
/// - 本ソフトウェアの一部又は全てを無断で複写複製（コピー）することは、
///   著作権侵害にあたりますので、これを禁止します。
/// - 本製品の使用に起因する侵害または特許権その他権利の侵害に関しては
///   当社は一切その責任を負いません。
///
////////////////////////////////////////////////////////////////////////////////

/*****************************************************************************/
/*****************************************************************************/
/*  ヘッダファイルのインクルード                                              */
/*****************************************************************************/
/*****************************************************************************/
#include <Arduino.h>
#include "sac_ui.h"

/*****************************************************************************/
/*****************************************************************************/
/*  自ヘッダファイルのインクルード                                            */
#define __GLOBAL_DEFINE__
/*****************************************************************************/
#include "app_ui.h"


/*****************************************************************************/
/*****************************************************************************/
/* 型定義                                                                    */
/*****************************************************************************/
/*****************************************************************************/

////////////////////////////////////////////////////////////////////////////////
/// @typedef    typedef名
/// @brief      typedefの説明
///
////////////////////////////////////////////////////////////////////////////////



/*****************************************************************************/
/*****************************************************************************/
/* マクロ */
/*****************************************************************************/
/*****************************************************************************/
/////////////////////////////////////////////////////////////////////////////////
/// @def        define名
/// @brief      defineの説明
///
////////////////////////////////////////////////////////////////////////////////

/*****************************************************************************/
/*****************************************************************************/
/* クラス */
/*****************************************************************************/
/*****************************************************************************/

///////////////////////////////////////////////////////////////////////////////
/// @class      class名
/// @brief      classの説明
///
////////////////////////////////////////////////////////////////////////////////

////////////////////////////////////////////////////////////////////////////////
/// @struct     構造体名
/// @brief      構造体の説明
///
////////////////////////////////////////////////////////////////////////////////


////////////////////////////////////////////////////////////////////////////////
/// @enum       enum型名
/// @brief      enum型の説明
///
////////////////////////////////////////////////////////////////////////////////

/*****************************************************************************/
/*****************************************************************************/
/* 変数定義 */
/*****************************************************************************/
/*****************************************************************************/

////////////////////////////////////////////////////////////////////////////////
/// @var        ens_app_ui_swBuffe
/// @brief      Buffer of SW
///
////////////////////////////////////////////////////////////////////////////////
volatile en_sac_ui_sw ens_app_ui_swBuffer[APP_UI_SW_BF_LEN];

////////////////////////////////////////////////////////////////////////////////
/// @var        ens_app_ui_swNow
/// @brief      Buffer of SW
///
////////////////////////////////////////////////////////////////////////////////
volatile en_sac_ui_sw ens_app_ui_swNow;

////////////////////////////////////////////////////////////////////////////////
/// @var        ens_app_ui_swLast
/// @brief      Last status  of SW
///
////////////////////////////////////////////////////////////////////////////////
volatile en_sac_ui_sw ens_app_ui_swLast;

////////////////////////////////////////////////////////////////////////////////
/// @var        ens_app_ui_swLtch
/// @brief      Latch information of sw
///
////////////////////////////////////////////////////////////////////////////////
volatile en_app_ui_sw_event ens_app_ui_swLtch;

/*****************************************************************************/
/*****************************************************************************/
/* 内部関数宣言 */
/*****************************************************************************/
/*****************************************************************************/
void vds_app_ui_swIntr(void);


/*****************************************************************************/
/*****************************************************************************/
/*****************************************************************************/
/* 関数定義 */
/*****************************************************************************/
/*****************************************************************************/
/*****************************************************************************/

/*****************************************************************************/
/*****************************************************************************/
/* グローバル関数定義 */
/*****************************************************************************/
/*****************************************************************************/

////////////////////////////////////////////////////////////////////////////////
/// @brief          関数の説明
/// @fn             関数名
/// @param[in]      引数(参照専用)
/// @param[out]     引数(ポインタ引数等)
/// @return         関数戻り値の説明
/// @author         関数作成者名
/// @date           関数作成年月日
/// @version        関数やソースにバージョンを明記する場合はここへ書き込む
/// @note           関数に備考などを明記する場合はここへ書き込む
/// @attention      関数に注意書きなどを明記する場合はここへ書き込む
/// @par            History
///                 ファイルに履歴などを明記する場合はここへ書き込む
///
////////////////////////////////////////////////////////////////////////////////
void vdg_app_ui_Setup(void)
{
    for (int cnt = 0; cnt < APP_UI_SW_BF_LEN; cnt++)
    {
        ens_app_ui_swBuffer[cnt] = SW_NON;
    }
    ens_app_ui_swNow = SW_NON;
    ens_app_ui_swLast = SW_NON;
}

////////////////////////////////////////////////////////////////////////////////
/// @brief          関数の説明
/// @fn             関数名
/// @param[in]      引数(参照専用)
/// @param[out]     引数(ポインタ引数等)
/// @return         関数戻り値の説明
/// @author         関数作成者名
/// @date           関数作成年月日
/// @version        関数やソースにバージョンを明記する場合はここへ書き込む
/// @note           関数に備考などを明記する場合はここへ書き込む
/// @attention      関数に注意書きなどを明記する場合はここへ書き込む
/// @par            History
///                 ファイルに履歴などを明記する場合はここへ書き込む
///
////////////////////////////////////////////////////////////////////////////////
void vdg_app_ui_intr(void)
{
    vds_app_ui_swIntr();
}


////////////////////////////////////////////////////////////////////////////////
/// @brief          関数の説明
/// @fn             関数名
/// @param[in]      引数(参照専用)
/// @param[out]     引数(ポインタ引数等)
/// @return         関数戻り値の説明
/// @author         関数作成者名
/// @date           関数作成年月日
/// @version        関数やソースにバージョンを明記する場合はここへ書き込む
/// @note           関数に備考などを明記する場合はここへ書き込む
/// @attention      関数に注意書きなどを明記する場合はここへ書き込む
/// @par            History
///                 ファイルに履歴などを明記する場合はここへ書き込む
///
////////////////////////////////////////////////////////////////////////////////
en_app_ui_sw_event eng_app_ui_swEvent(void)
{
    en_app_ui_sw_event ent_event = ens_app_ui_swLtch;
    if (ent_event == APP_UI_SW_NON)
    {
        return APP_UI_SW_NON;
    }
    else
    {
        noInterrupts();
        ens_app_ui_swLtch = APP_UI_SW_NON;
        interrupts();
        return ent_event;
    }
}


/*****************************************************************************/
/*****************************************************************************/
/* 内部関数定義 */
/*****************************************************************************/
/*****************************************************************************/

////////////////////////////////////////////////////////////////////////////////
/// @brief          関数の説明
/// @fn             void vds_app_ui_swIntr(void)
/// @param[in]      引数(参照専用)
/// @param[out]     引数(ポインタ引数等)
/// @return         関数戻り値の説明
/// @author         関数作成者名
/// @date           関数作成年月日
/// @version        関数やソースにバージョンを明記する場合はここへ書き込む
/// @note           関数に備考などを明記する場合はここへ書き込む
/// @attention      関数に注意書きなどを明記する場合はここへ書き込む
/// @par            History
///                 ファイルに履歴などを明記する場合はここへ書き込む
///
////////////////////////////////////////////////////////////////////////////////
void vds_app_ui_swIntr(void)
{
    ens_app_ui_swNow = eng_sac_ui_sw();
    ens_app_ui_swBuffer[0] = ens_app_ui_swNow;
    for (int cnt = 1; cnt < (APP_UI_SW_BF_LEN - 1); cnt++)
    {
        ens_app_ui_swBuffer[cnt + 1] = ens_app_ui_swBuffer[cnt];
    }
    ens_app_ui_swLast = ens_app_ui_swBuffer[1];

    if (ens_app_ui_swLast ==  SW_NON)
    {
        if (ens_app_ui_swNow == SW_GO)
        {
            ens_app_ui_swLtch = APP_UI_SW_NON_GO;
        }
        else if (ens_app_ui_swNow == SW_ESC)
        {
            ens_app_ui_swLtch = APP_UI_SW_NON_ESC;
        }
        else if (ens_app_ui_swNow == SW_UP)
        {
            ens_app_ui_swLtch = APP_UI_SW_NON_UP;
        }
        else if (ens_app_ui_swNow == SW_DOWN)
        {
            ens_app_ui_swLtch = APP_UI_SW_NON_DOWN;
        }
    }
}

/*********************EOF******************************************************/