////////////////////////////////////////////////////////////////////////////////
/// @file           sys_loop.c
/// @brief          ファイルの説明
/// @author         作成者
/// @date           ファイル作成年月日
/// $Version:       ファイルバージョン$
/// $Revision:      ファイルリビジョン$
/// @note           ファイルに備考などを明記する場合はここへ書き込む
/// @attention      ファイルに注意書きなどを明記する場合はここへ書き込む
/// @par            History
///                 ファイルに履歴などを明記する場合はここへ書き込む
///
/// Copyright (c) YYYY Sample Inc. All Rights reserved.
///
/// - 本ソフトウェアの一部又は全てを無断で複写複製（コピー）することは、
///   著作権侵害にあたりますので、これを禁止します。
/// - 本製品の使用に起因する侵害または特許権その他権利の侵害に関しては
///   当社は一切その責任を負いません。
///
////////////////////////////////////////////////////////////////////////////////

/*****************************************************************************/
/*****************************************************************************/
/*  ヘッダファイルのインクルード                                              */
/*****************************************************************************/
/*****************************************************************************/
#include <Arduino.h>
#include "typedef_arduino.h"
#include "sac_ui.h"
#include "sac_sys.h"
#include "app_ui.h"

#include "sys_intr.h"

/*****************************************************************************/
/*****************************************************************************/
/*  自ヘッダファイルのインクルード                                            */
#define __GLOBAL_DEFINE__
/*****************************************************************************/
#include "sys_loop.h"

/*****************************************************************************/
/*****************************************************************************/
/* 型定義                                                                    */
/*****************************************************************************/
/*****************************************************************************/

////////////////////////////////////////////////////////////////////////////////
/// @typedef    typedef名
/// @brief      typedefの説明
///
////////////////////////////////////////////////////////////////////////////////



/*****************************************************************************/
/*****************************************************************************/
/* マクロ */
/*****************************************************************************/
/*****************************************************************************/
/////////////////////////////////////////////////////////////////////////////////
/// @def        define名
/// @brief      defineの説明
///
////////////////////////////////////////////////////////////////////////////////

/*****************************************************************************/
/*****************************************************************************/
/* クラス */
/*****************************************************************************/
/*****************************************************************************/

///////////////////////////////////////////////////////////////////////////////
/// @class      class名
/// @brief      classの説明
///
////////////////////////////////////////////////////////////////////////////////

////////////////////////////////////////////////////////////////////////////////
/// @struct     構造体名
/// @brief      構造体の説明
///
////////////////////////////////////////////////////////////////////////////////


////////////////////////////////////////////////////////////////////////////////
/// @enum       enum型名
/// @brief      enum型の説明
///
////////////////////////////////////////////////////////////////////////////////

/*****************************************************************************/
/*****************************************************************************/
/* 変数定義 */
/*****************************************************************************/
/*****************************************************************************/

////////////////////////////////////////////////////////////////////////////////
/// @var        変数名
/// @brief      変数の説明
///
////////////////////////////////////////////////////////////////////////////////

/*****************************************************************************/
/*****************************************************************************/
/* 内部関数宣言 */
/*****************************************************************************/
/*****************************************************************************/

/*****************************************************************************/
/*****************************************************************************/
/*****************************************************************************/
/* 関数定義 */
/*****************************************************************************/
/*****************************************************************************/
/*****************************************************************************/

/*****************************************************************************/
/*****************************************************************************/
/* グローバル関数定義 */
/*****************************************************************************/
/*****************************************************************************/

////////////////////////////////////////////////////////////////////////////////
/// @brief          関数の説明
/// @fn             関数名
/// @param[in]      引数(参照専用)
/// @param[out]     引数(ポインタ引数等)
/// @return         関数戻り値の説明
/// @author         関数作成者名
/// @date           関数作成年月日
/// @version        関数やソースにバージョンを明記する場合はここへ書き込む
/// @note           関数に備考などを明記する場合はここへ書き込む
/// @attention      関数に注意書きなどを明記する場合はここへ書き込む
/// @par            History
///                 ファイルに履歴などを明記する場合はここへ書き込む
///
////////////////////////////////////////////////////////////////////////////////
void vdg_sys_loop_mainloop(void)
{
    Serial.println(eng_sac_ui_sw());
    Serial.println(s16g_sac_sys_pwrtempRead());
    Serial.println(u16_testcnt);
    if (eng_app_ui_swEvent() == APP_UI_SW_NON_GO)
    {
        vdg_sac_ui_tone_pi();
    }
    else if (eng_app_ui_swEvent() == APP_UI_SW_NON_ESC)
    {
        vdg_sac_ui_tone_WRN();
    }
    else if (eng_app_ui_swEvent() == APP_UI_SW_NON_UP)
    {
        vdg_sac_ui_tone_piroU();
    }
    else if (eng_app_ui_swEvent() == APP_UI_SW_NON_DOWN)
    {
        vdg_sac_ui_tone_piroD();
    }
}

/*****************************************************************************/
/*****************************************************************************/
/* 内部関数定義 */
/*****************************************************************************/
/*****************************************************************************/

////////////////////////////////////////////////////////////////////////////////
/// @brief          関数の説明
/// @fn             関数名
/// @param[in]      引数(参照専用)
/// @param[out]     引数(ポインタ引数等)
/// @return         関数戻り値の説明
/// @author         関数作成者名
/// @date           関数作成年月日
/// @version        関数やソースにバージョンを明記する場合はここへ書き込む
/// @note           関数に備考などを明記する場合はここへ書き込む
/// @attention      関数に注意書きなどを明記する場合はここへ書き込む
/// @par            History
///                 ファイルに履歴などを明記する場合はここへ書き込む
///
////////////////////////////////////////////////////////////////////////////////

/*********************EOF******************************************************/